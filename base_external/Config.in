## base_external/Config.in
```kconfig
source "/home/mohamed/assignment-5-MohamedTarek512/base_external/package/aesd-assignments/Config.in"
```

## base_external/package/HelloWorld/Config.in
```kconfig
config BR2_PACKAGE_HELLOWORLD
    bool "HelloWorld"
    help
      This is a custom binary package called HelloWorld.
```
